## CMakeLists.txt
```
#
# Copyright (c) 2025 HARDWARIO a.s.
#
# SPDX-License-Identifier: Apache-2.0
#

cmake_minimum_required(VERSION 3.20.0)

find_package(Zephyr REQUIRED HINTS $ENV{ZEPHYR_BASE})
project(sticker)

# Firmware version + source baked into the image (logged at boot, reported by
# the GetInfo command). CI passes the numeric version components and build type
# via -DAPP_VERSION_* / -DAPP_BUILD_TYPE (see .github/workflows/build.yml):
#   tag v1.3.4 -> 1/3/4, type 0 (MAIN)
#   branch/PR  -> 0/0/0, type 1 (DEV)
# Local builds (no override) derive the version from the latest git tag and are
# always type 2 (CUSTOM); they fall back to 0/0/0 if git/tags are unavailable.
# The debug/release config is a separate axis (CONFIG_FW_DEBUG), not set here.
if(NOT DEFINED APP_VERSION_MAJOR)
  set(APP_BUILD_TYPE 2) # CUSTOM
  execute_process(
    COMMAND git describe --tags --abbrev=0
    WORKING_DIRECTORY ${CMAKE_CURRENT_SOURCE_DIR}
    OUTPUT_VARIABLE APP_GIT_TAG
    OUTPUT_STRIP_TRAILING_WHITESPACE
    ERROR_QUIET)
  if(APP_GIT_TAG MATCHES "^v?([0-9]+)\\.([0-9]+)\\.([0-9]+)")
    set(APP_VERSION_MAJOR ${CMAKE_MATCH_1})
    set(APP_VERSION_MINOR ${CMAKE_MATCH_2})
    set(APP_VERSION_PATCH ${CMAKE_MATCH_3})
  else()
    set(APP_VERSION_MAJOR 0)
    set(APP_VERSION_MINOR 0)
    set(APP_VERSION_PATCH 0)
  endif()
endif()
add_compile_definitions(
  APP_VERSION_MAJOR=${APP_VERSION_MAJOR}
  APP_VERSION_MINOR=${APP_VERSION_MINOR}
  APP_VERSION_PATCH=${APP_VERSION_PATCH}
  APP_BUILD_TYPE=${APP_BUILD_TYPE})
message(STATUS "Firmware version: ${APP_VERSION_MAJOR}.${APP_VERSION_MINOR}.${APP_VERSION_PATCH} (build type ${APP_BUILD_TYPE})")

list(APPEND CMAKE_MODULE_PATH ${ZEPHYR_BASE}/modules/nanopb)
include(nanopb)

# Note: nanopb generates src/app_config.pb.{c,h} here; west configen generates
# src/app_config.{c,h} (struct/Settings/shell) from app_config.yml. Different
# extensions, same stem — no clash.
zephyr_nanopb_sources(app src/app_config.proto)

target_sources_ifdef(CONFIG_ADC app PRIVATE src/app_battery.c)
target_sources_ifdef(CONFIG_APP_FLOOD_PROBE app PRIVATE src/app_flood_probe.c)
target_sources_ifdef(CONFIG_DS28E17 app PRIVATE src/app_machine_probe.c)
target_sources_ifdef(CONFIG_LIS2DH app PRIVATE src/app_accel.c)
target_sources_ifdef(CONFIG_LORAWAN app PRIVATE src/app_lrw.c)
target_include_directories_ifdef(CONFIG_LORAWAN app PRIVATE
  ${ZEPHYR_LORAMAC_NODE_MODULE_DIR}/src/mac
  ${ZEPHYR_LORAMAC_NODE_MODULE_DIR}/src/mac/region
  ${ZEPHYR_LORAMAC_NODE_MODULE_DIR}/src/system
  ${ZEPHYR_LORAMAC_NODE_MODULE_DIR}/src/boards
)
target_sources_ifdef(CONFIG_OPT3001 app PRIVATE src/app_opt3001.c)
target_sources_ifdef(CONFIG_SHELL app PRIVATE src/app_ats.c)
target_sources_ifdef(CONFIG_SHT4X app PRIVATE src/app_sht4x.c)
target_sources_ifdef(CONFIG_W1 app PRIVATE src/app_ds18b20.c)
target_sources_ifdef(CONFIG_W1 app PRIVATE src/app_w1.c)
target_sources_ifdef(CONFIG_W1 app PRIVATE src/app_w1_slots.c)
target_sources_ifdef(CONFIG_WATCHDOG app PRIVATE src/app_wdog.c)
target_sources(app PRIVATE src/app_alarm.c)
target_sources(app PRIVATE src/app_alarm_rules.c)
target_sources(app PRIVATE src/app_calibration.c)
target_sources(app PRIVATE src/app_clock.c)
target_sources(app PRIVATE src/app_cmd.c)
target_sources(app PRIVATE src/app_compose.c)
target_sources(app PRIVATE src/app_config.c)
target_sources(app PRIVATE src/app_hall.c)
target_sources(app PRIVATE src/app_history.c)
target_sources(app PRIVATE src/app_input.c)
target_sources(app PRIVATE src/app_led.c)
target_sources(app PRIVATE src/app_mpl3115a2.c)
target_sources(app PRIVATE src/app_ndef_parser.c)
target_sources(app PRIVATE src/app_config_ingest.c)
target_sources(app PRIVATE src/app_nfc.c)
target_sources(app PRIVATE src/app_pyq1648.c)
target_sources(app PRIVATE src/app_sensor.c)
target_sources(app PRIVATE src/app_settings.c)
target_sources(app PRIVATE src/main.c)
```

## Kconfig
```
#
# Copyright (c) 2025 HARDWARIO a.s.
#
# SPDX-License-Identifier: Apache-2.0
#

menu "Application"

config APP_VERBOSE_LOGGING
	bool "Enable verbose parameter logging"
	default y
	help
	  Enable verbose logging of all configuration parameters.
	  This adds detailed logging for NFC parameters and other
	  configuration changes. Disable to save flash space.

config FW_DEBUG
	bool "Debug firmware indication"
	default n
	help
	  Enable debug firmware LED indication.
	  When enabled, the periodic LED blink shows green + yellow
	  instead of just green to indicate debug build.

config APP_LORAWAN_1_1
	bool "Use LoRaWAN 1.1.x crypto for OTAA"
	default n
	help
	  Enable LoRaWAN 1.1.x crypto for OTAA join: feed `lrw_nwkkey` into
	  the NwkKey slot (distinct from AppKey). When disabled (default,
	  LoRaWAN 1.0.x), the firmware copies `lrw_appkey` into both the
	  NwkKey and AppKey slots so the JoinRequest MIC is computed from
	  AppKey — required for 1.0.x network servers (TTN, ChirpStack,
	  Helium).

	  Enabling this also requires the LoRaMac library to be built with
	  USE_LRWAN_1_1_X_CRYPTO=1; the Kconfig only flips the app-level
	  key wiring.

config APP_CMD_DEBUG_SHELL
	bool "Shell injector for downlink command dispatcher"
	depends on SHELL
	default n
	help
	  Enable `tester cmd <transport> <hex>` for end-to-end testing
	  of the downlink command dispatcher without a LoRaWAN gateway.
	  The hex payload is fed to app_cmd_handle as if it had arrived
	  from the given transport (lrw or nfc) and the encoded response
	  is logged and (for lrw) queued on port 85.

config APP_HISTORY_FLASH
	bool "Persist sensor history in the history_partition flash"
	default y
	help
	  Store the sensor history store-and-forward buffer in the dedicated
	  history_partition flash (NVS), surviving reboot and power loss.
	  Disable to use a __noinit RAM ring of CONFIG_APP_HISTORY_BYTES
	  instead; data is then lost on power loss.

	  Builds with this enabled must keep CONFIG_FLASH_LOAD_SIZE at the
	  history_partition offset so the linker stops the image from growing
	  into the runtime-written flash (see prj.conf); builds with it
	  disabled (debug.conf) may relax the budget up to the
	  storage_partition offset.

config APP_HISTORY_BYTES
	int "History RAM fallback ring size (bytes)"
	default 1024
	help
	  Size of the in-RAM history ring used when CONFIG_APP_HISTORY_FLASH=n.
	  Record size is variable (5-33 B) depending on the enabled sensor set.

config APP_FLOOD_PROBE
	bool "Flood probe (ADS122C04 resistive flood sensor over DS28E17)"
	depends on DS28E17
	default y
	help
	  Support the 1-Wire flood probe: the HARDWARIO "weight probe" board
	  (ADS122C04 24-bit ADC behind a DS28E17 1-Wire-to-I2C bridge, family
	  0x19) repurposed for a resistive flood/water sensor. The ADS122C04
	  drives 1500 uA into AIN2 and measures the AIN2 voltage; a discovered
	  probe occupies a 1-Wire slot and reports the voltage (mV) in telemetry,
	  with a configurable flood alarm threshold. Disable to drop the driver
	  from the image (e.g. to reclaim flash on the release budget).

endmenu

menu "Zephyr Kernel"
source "Kconfig.zephyr"
endmenu
```

## prj.conf
```kconfig
CONFIG_HEAP_MEM_POOL_SIZE=2048
CONFIG_IDLE_STACK_SIZE=512
CONFIG_ISR_STACK_SIZE=2048
CONFIG_MAIN_STACK_SIZE=4096
CONFIG_SYSTEM_WORKQUEUE_STACK_SIZE=2048

CONFIG_REBOOT=y
CONFIG_I2C=y
CONFIG_SENSOR=y
CONFIG_PM=y
CONFIG_PM_DEVICE=y
CONFIG_PM_DEVICE_RUNTIME=y

CONFIG_SPI=y

CONFIG_NVS=y
CONFIG_FLASH=y
CONFIG_FLASH_MAP=y
CONFIG_SETTINGS=y

# Image size budget — must equal the history_partition offset (sticker.dts):
# with CONFIG_APP_HISTORY_FLASH=y (release default) the history NVS rewrites
# that area at runtime, and NVS settings + LoRaWAN NVM always rewrite the
# storage_partition. An image leaking into either region gets corrupted in
# flash → hard fault on next boot, recoverable only by mass erase. With this
# set, the linker fails the build instead ("region ROM overflowed").
# debug.conf (history kept in RAM) relaxes this to the storage offset 0x3C000.
CONFIG_FLASH_LOAD_SIZE=0x28000

CONFIG_LORA=y
CONFIG_LORAMAC_REGION_AU915=y
CONFIG_LORAMAC_REGION_EU868=y
CONFIG_LORAMAC_REGION_US915=y
CONFIG_LORAWAN_NVM_SETTINGS=y
CONFIG_LORAWAN=y
CONFIG_LORAWAN_SYSTEM_MAX_RX_ERROR=100

# Wall-clock: STM32 RTC (LSE-backed) set from LoRaWAN DeviceTimeReq. See app_clock.c.
CONFIG_RTC=y
CONFIG_RTC_STM32=y

CONFIG_LIS2DH_ACCEL_RANGE_4G=y
CONFIG_LIS2DH_BLOCK_DATA_UPDATE=y
CONFIG_LIS2DH_ODR_5=y
CONFIG_LIS2DH_OPER_MODE_LOW_POWER=y
CONFIG_LIS2DH_TRIGGER_GLOBAL_THREAD=y

CONFIG_ENTROPY_GENERATOR=y

CONFIG_WATCHDOG=y
CONFIG_WDT_DISABLE_AT_BOOT=y

CONFIG_ADC=y

CONFIG_LIS2DH=y
CONFIG_MPL3115A2=y
CONFIG_OPT3001=y
CONFIG_SHT4X=y
CONFIG_W1=y

# Flood probe (ADS122C04 resistive flood sensor behind a DS28E17 1-Wire bridge).
# Shipped in the main image like the other sensors; flip to n to reclaim flash if
# the release image (CONFIG_FLASH_LOAD_SIZE budget) ever overflows.
CONFIG_APP_FLOOD_PROBE=y

CONFIG_NET_BUF=y
CONFIG_NANOPB=y

CONFIG_MBEDTLS=y
CONFIG_MBEDTLS_PSA_CRYPTO_C=y
CONFIG_PSA_WANT_KEY_TYPE_AES=y
CONFIG_PSA_WANT_ALG_CCM=y
```

## src/app_alarm.c
```c
/*
 * Copyright (c) 2025-2026 HARDWARIO a.s.
 *
 * SPDX-License-Identifier: Apache-2.0
 */

#include "app_alarm.h"
#include "app_alarm_rules.h"
#include "app_cmd.h"
#include "app_config.h"
#include "app_log.h"
#include "app_lrw.h"
#include "app_sensor.h"

#if defined(__has_include) && __has_include("app_clock.h")
#include "app_clock.h"
#define APP_ALARM_HAVE_CLOCK 1
#endif

/* Zephyr includes */
#include <zephyr/init.h>
#include <zephyr/kernel.h>
#include <zephyr/logging/log.h>
#include <zephyr/sys/util.h>

/* Standard includes */
#include <errno.h>
#include <math.h>
#include <stdbool.h>
#include <stdint.h>

LOG_MODULE_REGISTER(app_alarm, LOG_LEVEL_DBG);

/* Wire enum values (AlarmEvent.Side / .Edge). */
#define ALARM_SIDE_NONE  0
#define ALARM_SIDE_LO    1
#define ALARM_SIDE_HI    2
#define ALARM_EDGE_ACT   0
#define ALARM_EDGE_DEACT 1

/* ---- per-rule runtime state (keyed by source+quantity, not rule index, so it
 * survives the rule list being reordered on clear) -------------------------- */

struct rstate {
	bool used;
	uint8_t source;
	uint8_t quantity;
	bool active;        /* alarm latched */
	uint8_t side;       /* threshold: which bound latched */
	uint8_t prev_state; /* STATE: last digital level seen */
	bool have_prev_state;
	uint32_t prev_count; /* COUNT: baseline counter */
	bool have_prev_count;
	int64_t oneshot_expiry; /* STATE edge one-shot: auto-clear time (0 = none) */
};

static struct rstate m_rt[APP_ALARM_RULE_MAX];
static int64_t m_last_alarm_send_ms;
static app_alarm_event_cb m_event_cb;
static void *m_event_cb_user_data;

K_MUTEX_DEFINE(m_lock);

static struct rstate *rt_for(uint8_t source, uint8_t quantity)
{
	struct rstate *free = NULL;
	for (int i = 0; i < APP_ALARM_RULE_MAX; i++) {
		if (m_rt[i].used && m_rt[i].source == source && m_rt[i].quantity == quantity) {
			return &m_rt[i];
		}
		if (!m_rt[i].used && free == NULL) {
			free = &m_rt[i];
		}
	}
	if (free) {
		*free = (struct rstate){.used = true, .source = source, .quantity = quantity};
	}
	return free;
}

/* ---- Alarm-detail batch on fPort 3 (#27) -------------------------------- */

#define ALARM_BATCH_MAX 8
#define ALARM_FRAME_MAX 64

static struct app_cmd_alarm_event m_batch[ALARM_BATCH_MAX];
static uint8_t m_batch_count;
static uint16_t m_window_total;
static uint32_t m_window_base_unix;
static int64_t m_window_start_ms;
static bool m_window_open;
static struct k_work_delayable m_alarm_batch_work;

static inline int64_t notif_hold_ms(void)
{
	return (int64_t)g_app_config.alarm_notif_time * 1000;
}

static void alarm_lrw_send(void)
{
#if defined(CONFIG_LORAWAN)
	int limit = g_app_config.alarm_limit;
	int64_t now = k_uptime_get();

	if (limit > 0 && m_last_alarm_send_ms != 0 &&
	    (now - m_last_alarm_send_ms) < (int64_t)limit * 1000) {
		LOG_INF("Alarm uplink rate-limited (limit %d s)", limit);
		return;
	}
	m_last_alarm_send_ms = now;
	app_lrw_send();
#endif
}

static uint32_t now_unix_or_uptime(void)
{
#ifdef APP_ALARM_HAVE_CLOCK
	uint32_t u;
	if (app_clock_get_unix(&u) == 0) {
		return u;
	}
#endif
	return (uint32_t)(k_uptime_get() / 1000);
}

static void alarm_batch_flush(void)
{
	if (m_batch_count == 0) {
		m_window_open = false;
		m_window_total = 0;
		return;
	}

	size_t cap = ALARM_FRAME_MAX;
#if defined(CONFIG_LORAWAN)
	uint8_t dr = app_lrw_get_max_payload();
	if (dr > 0 && dr < cap) {
		cap = dr;
	}
#endif

	uint8_t buf[ALARM_FRAME_MAX];
	size_t len = 0;
	uint8_t n = m_batch_count;
	int ret = -EMSGSIZE;

	while (n > 0) {
		ret = app_cmd_build_alarm_report(m_window_base_unix, m_window_total, m_batch, n,
						 buf, cap, &len);
		if (ret == 0) {
			break;
		}
		n--;
	}

	if (ret == 0) {
#if defined(CONFIG_LORAWAN)
		(void)app_lrw_send_alarm(buf, len);
#endif
		LOG_INF("Alarm batch: %u/%u events on fPort 3 (%u B)", n, m_window_total,
			(unsigned)len);
	} else {
		LOG_ERR_CALL_FAILED_INT("app_cmd_build_alarm_report", ret);
	}

	m_batch_count = 0;
	m_window_total = 0;
	m_window_open = false;
}

static void alarm_batch_work_handler(struct k_work *work)
{
	ARG_UNUSED(work);
	k_mutex_lock(&m_lock, K_FOREVER);
	alarm_batch_flush();
	k_mutex_unlock(&m_lock);
}

/* Record one alarm edge for the fPort-3 detail batch. Caller does NOT hold
 * m_lock (this takes it). */
static void alarm_collect(uint8_t source, uint8_t quantity, bool active, uint8_t side,
			  bool has_value, int32_t value)
{
	int limit = g_app_config.alarm_limit;
	int64_t now = k_uptime_get();
	struct app_cmd_alarm_event ev = {
		.source = source,
		.quantity = quantity,
		.edge = active ? ALARM_EDGE_ACT : ALARM_EDGE_DEACT,
		.side = side,
		.has_value = has_value,
		.value = value,
		.rel_s = 0,
	};

	k_mutex_lock(&m_lock, K_FOREVER);

	if (limit <= 0) {
		m_window_base_unix = now_unix_or_uptime();
		m_window_total = 1;
		m_batch_count = 1;
		m_batch[0] = ev;
		alarm_batch_flush();
		k_mutex_unlock(&m_lock);
		return;
	}

	if (!m_window_open) {
		m_window_open = true;
		m_window_start_ms = now;
		m_window_base_unix = now_unix_or_uptime();
		m_window_total = 0;
		m_batch_count = 0;
		k_work_schedule(&m_alarm_batch_work, K_SECONDS(limit));
	}

	m_window_total++;
	if (m_batch_count < ALARM_BATCH_MAX) {
		ev.rel_s = (uint32_t)MIN((now - m_window_start_ms) / 1000, 0xFFFF);
		m_batch[m_batch_count++] = ev;
	}

	k_mutex_unlock(&m_lock);
}

/* ---- value access (source, quantity) ------------------------------------ */

/* Wire scaling per quantity for the fPort-3 detail value. */
static int32_t alarm_scale(enum app_alarm_quantity q, float v)
{
	switch (q) {
	case APP_ALARM_Q_TEMPERATURE:
	case APP_ALARM_Q_HUMIDITY:
		return (int32_t)lroundf(v * 100.0f);
	case APP_ALARM_Q_PRESSURE:
		return (int32_t)lroundf(v * 10.0f); /* v already in hPa -> hPa×10 wire */
	case APP_ALARM_Q_MAGNETIC_FIELD:
		return (int32_t)lroundf(v * 1000.0f); /* mT -> µT */
	case APP_ALARM_Q_ILLUMINANCE:
	default:
		return (int32_t)lroundf(v);
	}
}

/* Read the analog value for a THRESHOLD rule. Returns false if the (source,
 * quantity) pair has no analog reading (caller treats as NaN/absent). Caller
 * holds g_app_sensor_data_lock. */
static bool read_threshold_value(uint8_t source, uint8_t quantity, float *out)
{
	const struct app_sensor_data *d = &g_app_sensor_data;

	if (source == APP_ALARM_SRC_ONBOARD) {
		switch (quantity) {
		case APP_ALARM_Q_TEMPERATURE:
			*out = d->temperature;
			return true;
		case APP_ALARM_Q_HUMIDITY:
			*out = d->humidity;
			return true;
		case APP_ALARM_Q_PRESSURE:
			*out = d->pressure * 10.0f; /* kPa -> hPa (config thresholds are hPa) */
			return true;
		default:
			return false;
		}
	}
	if (source >= APP_ALARM_SRC_SLOT1 && source <= APP_ALARM_SRC_SLOT4) {
		const struct app_w1_slot_reading *r = &d->w1[source - APP_ALARM_SRC_SLOT1];
		switch (quantity) {
		case APP_ALARM_Q_TEMPERATURE:
			*out = r->temperature;
			return true;
		case APP_ALARM_Q_HUMIDITY:
			*out = r->humidity;
			return true;
		case APP_ALARM_Q_ILLUMINANCE:
			*out = r->illuminance;
			return true;
		case APP_ALARM_Q_MAGNETIC_FIELD:
			*out = r->magnetic_field;
			return true;
		case APP_ALARM_Q_FLOOD:
			*out = r->flood;
			return true;
		default:
			return false;
		}
	}
	return false;
}

/* Current counter for a COUNT rule's source. Caller holds the data lock. */
static bool read_counter(uint8_t source, uint32_t *out)
{
	const struct app_sensor_data *d = &g_app_sensor_data;
	switch (source) {
	case APP_ALARM_SRC_HALL_LEFT:
		*out = d->hall_left_count;
		return true;
	case APP_ALARM_SRC_HALL_RIGHT:
		*out = d->hall_right_count;
		return true;
	case APP_ALARM_SRC_INPUT_A:
		*out = d->input_a_count;
		return true;
	case APP_ALARM_SRC_INPUT_B:
		*out = d->input_b_count;
		return true;
	case APP_ALARM_SRC_PIR:
		*out = d->motion_count;
		return true;
	case APP_ALARM_SRC_ACCEL:
		*out = d->accel_motion_count;
		return true;
	default:
		return false;
	}
}

/* Current digital level for a STATE rule polled in app_alarm_poll (slot tilt).
 * hall/input/pir/accel STATE arrives via app_alarm_event, not here. */
static bool read_poll_state(uint8_t source, uint8_t quantity, bool *out)
{
	const struct app_sensor_data *d = &g_app_sensor_data;
	if (quantity == APP_ALARM_Q_TILT && source >= APP_ALARM_SRC_SLOT1 &&
	    source <= APP_ALARM_SRC_SLOT4) {
		*out = d->w1[source - APP_ALARM_SRC_SLOT1].is_tilt_alert;
		return true;
	}
	return false;
}

/* ---- rule evaluation ---------------------------------------------------- */

/* Threshold rule with hysteresis (reuses the previous eval_threshold logic,
 * keyed to the rule's runtime state). Returns latched state. */
static bool eval_threshold(const struct app_alarm_rule *rule, struct rstate *rt, float value,
			   bool *should_send)
{
	if (!rule->enabled || isnan(value)) {
		if (rt->active) {
			rt->active = false;
			*should_send = true;
			alarm_collect(rule->source, rule->quantity, false, rt->side, false, 0);
		}
		return false;
	}

	float lo = rule->lo, hi = rule->hi, hst = rule->hst;

	if (rt->active) {
		if (value > lo + hst && value < hi - hst) {
			rt->active = false;
			*should_send = true;
			alarm_collect(rule->source, rule->quantity, false, rt->side, true,
				      alarm_scale(rule->quantity, value));
		}
	} else if (value < lo - hst) {
		rt->active = true;
		rt->side = ALARM_SIDE_LO;
		*should_send = true;
		alarm_collect(rule->source, rule->quantity, true, ALARM_SIDE_LO, true,
			      alarm_scale(rule->quantity, value));
	} else if (value > hi + hst) {
		rt->active = true;
		rt->side = ALARM_SIDE_HI;
		*should_send = true;
		alarm_collect(rule->source, rule->quantity, true, ALARM_SIDE_HI, true,
			      alarm_scale(rule->quantity, value));
	}
	return rt->active;
}

/* STATE rule: from/to over a digital level. from != to is an edge (one-shot:
 * activate, auto-clear after alarm_notif_time, no deactivate); from == to is a
 * level (active while cur == to). */
static void eval_state(const struct app_alarm_rule *rule, struct rstate *rt, bool cur,
		       bool *should_send)
{
	bool is_edge = (rule->from_state != rule->to_state);
	uint8_t cur_lvl = cur ? 1 : 0;

	if (!rule->enabled) {
		if (rt->active) {
			rt->active = false;
			rt->oneshot_expiry = 0;
			*should_send = true;
			alarm_collect(rule->source, rule->quantity, false, ALARM_SIDE_NONE, true,
				      0);
		}
		rt->have_prev_state = true;
		rt->prev_state = cur_lvl;
		return;
	}

	if (is_edge) {
		/* Fire one-shot when the configured transition occurs. */
		if (rt->have_prev_state && rt->prev_state == rule->from_state &&
		    cur_lvl == rule->to_state) {
			rt->active = true;
			rt->oneshot_expiry = k_uptime_get() + notif_hold_ms();
			*should_send = true;
			alarm_collect(rule->source, rule->quantity, true, ALARM_SIDE_NONE, true,
				      cur_lvl);
		}
	} else {
		/* Level: active while cur == to. */
		bool want = (cur_lvl == rule->to_state);
		if (want && !rt->active) {
			rt->active = true;
			*should_send = true;
			alarm_collect(rule->source, rule->quantity, true, ALARM_SIDE_NONE, true,
				      cur_lvl);
		} else if (!want && rt->active) {
			rt->active = false;
			*should_send = true;
			alarm_collect(rule->source, rule->quantity, false, ALARM_SIDE_NONE, true,
				      cur_lvl);
		}
	}

	rt->have_prev_state = true;
	rt->prev_state = cur_lvl;
}

/* COUNT rate rule: alarm when the counter rose by >= hi since the last fire.
 * The underlying counters in g_app_sensor_data only refresh per sample/report,
 * so this is effectively a per-report rate. One-shot (auto-clear). */
static void eval_count(const struct app_alarm_rule *rule, struct rstate *rt, uint32_t cur,
		       bool *should_send)
{
	if (!rt->have_prev_count) {
		rt->have_prev_count = true;
		rt->prev_count = cur;
		return;
	}
	if (!rule->enabled) {
		rt->prev_count = cur;
		return;
	}
	uint32_t delta = cur - rt->prev_count; /* wraps correctly on uint32 */
	if (rule->hi > 0 && delta >= (uint32_t)rule->hi) {
		rt->active = true;
		rt->oneshot_expiry = k_uptime_get() + notif_hold_ms();
		*should_send = true;
		alarm_collect(rule->source, rule->quantity, true, ALARM_SIDE_NONE, true,
			      (int32_t)cur);
		rt->prev_count = cur;
	}
}

bool app_alarm_poll(void)
{
	bool should_send = false;
	bool alarm = false;
	int64_t now = k_uptime_get();

	k_mutex_lock(&g_app_sensor_data_lock, K_FOREVER);

	for (uint8_t i = 0; i < app_alarm_rules_count(); i++) {
		const struct app_alarm_rule *rule = app_alarm_rules_get(i);
		if (rule == NULL) {
			break;
		}
		struct rstate *rt = rt_for(rule->source, rule->quantity);
		if (rt == NULL) {
			continue;
		}

		switch (app_alarm_quantity_kind((enum app_alarm_quantity)rule->quantity)) {
		case APP_ALARM_KIND_THRESHOLD: {
			float v = NAN;
			read_threshold_value(rule->source, rule->quantity, &v);
			eval_threshold(rule, rt, v, &should_send);
			break;
		}
		case APP_ALARM_KIND_STATE: {
			/* Only slot tilt is polled here; hall/input/pir/accel come via
			 * app_alarm_event(). */
			bool st;
			if (read_poll_state(rule->source, rule->quantity, &st)) {
				eval_state(rule, rt, st, &should_send);
			}
			break;
		}
		case APP_ALARM_KIND_RATE: {
			uint32_t c;
			if (read_counter(rule->source, &c)) {
				eval_count(rule, rt, c, &should_send);
			}
			break;
		}
		}
	}

	k_mutex_unlock(&g_app_sensor_data_lock);

	/* Expire one-shot latches and collect "any active". */
	k_mutex_lock(&m_lock, K_FOREVER);
	for (int i = 0; i < APP_ALARM_RULE_MAX; i++) {
		if (!m_rt[i].used) {
			continue;
		}
		if (m_rt[i].oneshot_expiry != 0 && now >= m_rt[i].oneshot_expiry) {
			m_rt[i].active = false;
			m_rt[i].oneshot_expiry = 0;
		}
		if (m_rt[i].active) {
			alarm = true;
		}
	}
	k_mutex_unlock(&m_lock);

	if (should_send) {
		alarm_lrw_send();
	}
	return alarm;
}

void app_alarm_event(enum app_alarm_source source, bool active)
{
	/* Discrete edge → its STATE rule (if any). */
	const struct app_alarm_rule *rule = app_alarm_rules_find(source, APP_ALARM_Q_STATE);
	app_alarm_event_cb cb;
	void *user_data;

	k_mutex_lock(&m_lock, K_FOREVER);
	cb = m_event_cb;
	user_data = m_event_cb_user_data;
	k_mutex_unlock(&m_lock);

	if (rule != NULL) {
		struct rstate *rt = rt_for(source, APP_ALARM_Q_STATE);
		if (rt != NULL) {
			bool should_send = false;
			eval_state(rule, rt, active, &should_send);
			if (should_send) {
				alarm_lrw_send();
			}
		}
	}

	if (cb) {
		cb(source, active, user_data);
	}
}

int app_alarm_set_event_callback(app_alarm_event_cb cb, void *user_data)
{
	k_mutex_lock(&m_lock, K_FOREVER);
	m_event_cb = cb;
	m_event_cb_user_data = user_data;
	k_mutex_unlock(&m_lock);
	return 0;
}

bool app_alarm_is_active(enum app_alarm_source source, enum app_alarm_quantity quantity)
{
	bool a = false;
	k_mutex_lock(&m_lock, K_FOREVER);
	for (int i = 0; i < APP_ALARM_RULE_MAX; i++) {
		if (m_rt[i].used && m_rt[i].source == source && m_rt[i].quantity == quantity) {
			a = m_rt[i].active;
			break;
		}
	}
	k_mutex_unlock(&m_lock);
	return a;
}

/* ---- shell -------------------------------------------------------------- */

#if defined(CONFIG_SHELL)
#include <zephyr/shell/shell.h>
#include <stdlib.h>
#include <string.h>

static int cmd_alarm_list(const struct shell *sh, size_t argc, char **argv)
{
	ARG_UNUSED(argc);
	ARG_UNUSED(argv);

	uint8_t n = app_alarm_rules_count();
	shell_print(sh, "%u rule(s):", n);
	for (uint8_t i = 0; i < n; i++) {
		const struct app_alarm_rule *r = app_alarm_rules_get(i);
		const char *src = app_alarm_source_name(r->source);
		const char *q = app_alarm_quantity_name(r->quantity);
		bool active = app_alarm_is_active(r->source, r->quantity);
		switch (app_alarm_quantity_kind(r->quantity)) {
		case APP_ALARM_KIND_THRESHOLD:
			shell_print(sh, "  %s %s  lo=%.2f hi=%.2f hst=%.2f  en=%d  active=%d", src,
				    q, (double)r->lo, (double)r->hi, (double)r->hst, r->enabled,
				    active);
			break;
		case APP_ALARM_KIND_STATE:
			shell_print(sh, "  %s %s  %u->%u (%s)  en=%d  active=%d", src, q,
				    r->from_state, r->to_state,
				    r->from_state == r->to_state ? "level" : "edge", r->enabled,
				    active);
			break;
		case APP_ALARM_KIND_RATE:
			shell_print(sh, "  %s %s  rate>=%d/interval  en=%d  active=%d", src, q,
				    (int)r->hi, r->enabled, active);
			break;
		}
	}
	return 0;
}

static int cmd_alarm_set(const struct shell *sh, size_t argc, char **argv)
{
	int src = app_alarm_source_by_name(argv[1]);
	int qty = app_alarm_quantity_by_name(argv[2]);
	if (src < 0 || qty < 0 ||
	    !app_alarm_rule_valid((enum app_alarm_source)src, (enum app_alarm_quantity)qty)) {
		shell_error(sh, "invalid <source> <quantity>");
		return -EINVAL;
	}

	struct app_alarm_rule r = {.source = (uint8_t)src, .quantity = (uint8_t)qty, .enabled = 1};

	switch (app_alarm_quantity_kind((enum app_alarm_quantity)qty)) {
	case APP_ALARM_KIND_THRESHOLD:
		if (argc < 5) {
			shell_error(sh, "usage: alarm set <source> <quantity> <lo> <hi> [hst]");
			return -EINVAL;
		}
		r.lo = strtof(argv[3], NULL);
		r.hi = strtof(argv[4], NULL);
		r.hst = (argc >= 6) ? strtof(argv[5], NULL) : 0.0f;
		break;
	case APP_ALARM_KIND_STATE:
		if (argc < 5) {
			shell_error(sh, "usage: alarm set <source> <quantity> <from> <to> "
					"(0/1; from!=to=edge, from==to=level)");
			return -EINVAL;
		}
		r.from_state = (uint8_t)(strtoul(argv[3], NULL, 10) ? 1 : 0);
		r.to_state = (uint8_t)(strtoul(argv[4], NULL, 10) ? 1 : 0);
		break;
	case APP_ALARM_KIND_RATE:
		if (argc < 4) {
			shell_error(sh, "usage: alarm set <source> count <N-per-interval>");
			return -EINVAL;
		}
		r.hi = (float)strtoul(argv[3], NULL, 10);
		break;
	}

	int ret = app_alarm_rules_set(&r);
	if (ret) {
		shell_error(sh, "set failed: %d%s", ret,
			    ret == -ENOSPC ? " (rule table full)" : "");
		return ret;
	}
	ret = app_alarm_rules_save();
	shell_print(sh, "rule set%s", ret ? " (NOT persisted!)" : "");
	return 0;
}

/* Force a sample + one evaluation pass now and report whether any alarm is
 * active. The main loop only calls app_alarm_poll() in the HEALTHY state, so on
 * a bench device (not joined) this is how a test exercises the rules. */
static int cmd_alarm_poll(const struct shell *sh, size_t argc, char **argv)
{
	ARG_UNUSED(argc);
	ARG_UNUSED(argv);
	app_sensor_sample();
	bool any = app_alarm_poll();
	shell_print(sh, "polled; any active: %s", any ? "yes" : "no");
	return 0;
}

static int cmd_alarm_clear(const struct shell *sh, size_t argc, char **argv)
{
	if (argc == 1) {
		app_alarm_rules_clear_all();
		(void)app_alarm_rules_save();
		shell_print(sh, "all rules cleared");
		return 0;
	}
	int src = app_alarm_source_by_name(argv[1]);
	int qty = (argc >= 3) ? app_alarm_quantity_by_name(argv[2]) : -1;
	if (src < 0 || qty < 0) {
		shell_error(sh, "usage: alarm clear [<source> <quantity>]");
		return -EINVAL;
	}
	int ret = app_alarm_rules_clear((enum app_alarm_source)src, (enum app_alarm_quantity)qty);
	if (ret) {
		shell_error(sh, "clear failed: %d", ret);
		return ret;
	}
	(void)app_alarm_rules_save();
	shell_print(sh, "rule cleared");
	return 0;
}

SHELL_STATIC_SUBCMD_SET_CREATE(
	sub_alarm, SHELL_CMD_ARG(list, NULL, "List alarm rules.", cmd_alarm_list, 1, 0),
	SHELL_CMD_ARG(set, NULL,
		      "Set a rule. Usage: set <source> <quantity> <args>\n"
		      "  threshold: <lo> <hi> [hst]   state: <from> <to>   count: <N>",
		      cmd_alarm_set, 4, 2),
	SHELL_CMD_ARG(clear, NULL, "Clear a rule (or all). Usage: clear [<source> <quantity>]",
		      cmd_alarm_clear, 1, 2),
	SHELL_CMD_ARG(poll, NULL, "Sample + evaluate rules now (bench test).", cmd_alarm_poll, 1,
		      0),
	SHELL_SUBCMD_SET_END);

SHELL_CMD_REGISTER(alarm, &sub_alarm, "Dynamic alarm rules.", NULL);
#endif /* defined(CONFIG_SHELL) */

static int app_alarm_init(void)
{
	k_work_init_delayable(&m_alarm_batch_work, alarm_batch_work_handler);
	return 0;
}

SYS_INIT(app_alarm_init, APPLICATION, CONFIG_APPLICATION_INIT_PRIORITY);
```

## src/app_alarm_rules.c
```c
/*
 * Copyright (c) 2026 HARDWARIO a.s.
 *
 * SPDX-License-Identifier: Apache-2.0
 */

#include "app_alarm_rules.h"
#include "app_log.h"

/* Zephyr includes */
#include <zephyr/kernel.h>
#include <zephyr/logging/log.h>
#include <zephyr/settings/settings.h>

/* Standard includes */
#include <errno.h>
#include <stdint.h>
#include <string.h>

LOG_MODULE_REGISTER(app_alarm_rules, LOG_LEVEL_INF);

#define SETTINGS_SUBTREE "alarm"
#define SETTINGS_KEY     "alarm/rules"
#define BLOB_VERSION     1

static struct app_alarm_rule m_rules[APP_ALARM_RULE_MAX];
static uint8_t m_count;
static struct k_mutex m_lock;

/* ---- names -------------------------------------------------------------- */

static const char *const m_source_names[APP_ALARM_SRC_COUNT] = {
	[APP_ALARM_SRC_ONBOARD] = "onboard",
	[APP_ALARM_SRC_SLOT1] = "s1",
	[APP_ALARM_SRC_SLOT2] = "s2",
	[APP_ALARM_SRC_SLOT3] = "s3",
	[APP_ALARM_SRC_SLOT4] = "s4",
	[APP_ALARM_SRC_HALL_LEFT] = "hall-left",
	[APP_ALARM_SRC_HALL_RIGHT] = "hall-right",
	[APP_ALARM_SRC_INPUT_A] = "input-a",
	[APP_ALARM_SRC_INPUT_B] = "input-b",
	[APP_ALARM_SRC_PIR] = "pir",
	[APP_ALARM_SRC_ACCEL] = "accel",
};

static const char *const m_quantity_names[APP_ALARM_Q_QUANTITY_COUNT] = {
	[APP_ALARM_Q_TEMPERATURE] = "temperature",
	[APP_ALARM_Q_HUMIDITY] = "humidity",
	[APP_ALARM_Q_PRESSURE] = "pressure",
	[APP_ALARM_Q_ILLUMINANCE] = "illuminance",
	[APP_ALARM_Q_MAGNETIC_FIELD] = "magnetic-field",
	[APP_ALARM_Q_TILT] = "tilt",
	[APP_ALARM_Q_STATE] = "state",
	[APP_ALARM_Q_COUNT] = "count",
	[APP_ALARM_Q_FLOOD] = "flood",
};

const char *app_alarm_source_name(enum app_alarm_source source)
{
	if ((unsigned)source >= APP_ALARM_SRC_COUNT || !m_source_names[source]) {
		return "?";
	}
	return m_source_names[source];
}

const char *app_alarm_quantity_name(enum app_alarm_quantity quantity)
{
	if ((unsigned)quantity >= APP_ALARM_Q_QUANTITY_COUNT || !m_quantity_names[quantity]) {
		return "?";
	}
	return m_quantity_names[quantity];
}

int app_alarm_source_by_name(const char *name)
{
	for (int i = 0; i < APP_ALARM_SRC_COUNT; i++) {
		if (m_source_names[i] && strcmp(name, m_source_names[i]) == 0) {
			return i;
		}
	}
	return -1;
}

int app_alarm_quantity_by_name(const char *name)
{
	for (int i = 0; i < APP_ALARM_Q_QUANTITY_COUNT; i++) {
		if (m_quantity_names[i] && strcmp(name, m_quantity_names[i]) == 0) {
			return i;
		}
	}
	return -1;
}

/* ---- kind / validity ---------------------------------------------------- */

enum app_alarm_kind app_alarm_quantity_kind(enum app_alarm_quantity q)
{
	switch (q) {
	case APP_ALARM_Q_TILT:
	case APP_ALARM_Q_STATE:
		return APP_ALARM_KIND_STATE;
	case APP_ALARM_Q_COUNT:
		return APP_ALARM_KIND_RATE;
	default:
		return APP_ALARM_KIND_THRESHOLD;
	}
}

bool app_alarm_rule_valid(enum app_alarm_source source, enum app_alarm_quantity quantity)
{
	switch (source) {
	case APP_ALARM_SRC_ONBOARD:
		return quantity == APP_ALARM_Q_TEMPERATURE || quantity == APP_ALARM_Q_HUMIDITY ||
		       quantity == APP_ALARM_Q_PRESSURE;
	case APP_ALARM_SRC_SLOT1:
	case APP_ALARM_SRC_SLOT2:
	case APP_ALARM_SRC_SLOT3:
	case APP_ALARM_SRC_SLOT4:
		/* Structural: any quantity a 1-Wire slot could provide. The sensor need
		 * not be enrolled yet; eval yields NaN (inert) if it isn't present or
		 * its type doesn't supply the quantity. */
		return quantity == APP_ALARM_Q_TEMPERATURE || quantity == APP_ALARM_Q_HUMIDITY ||
		       quantity == APP_ALARM_Q_ILLUMINANCE ||
		       quantity == APP_ALARM_Q_MAGNETIC_FIELD || quantity == APP_ALARM_Q_TILT ||
		       quantity == APP_ALARM_Q_FLOOD;
	case APP_ALARM_SRC_HALL_LEFT:
	case APP_ALARM_SRC_HALL_RIGHT:
	case APP_ALARM_SRC_INPUT_A:
	case APP_ALARM_SRC_INPUT_B:
	case APP_ALARM_SRC_PIR:
	case APP_ALARM_SRC_ACCEL:
		return quantity == APP_ALARM_Q_STATE || quantity == APP_ALARM_Q_COUNT;
	default:
		return false;
	}
}

/* ---- CRUD --------------------------------------------------------------- */

uint8_t app_alarm_rules_count(void)
{
	return m_count;
}

const struct app_alarm_rule *app_alarm_rules_get(uint8_t idx)
{
	return (idx < m_count) ? &m_rules[idx] : NULL;
}

static int find_idx(enum app_alarm_source source, enum app_alarm_quantity quantity)
{
	for (int i = 0; i < m_count; i++) {
		if (m_rules[i].source == source && m_rules[i].quantity == quantity) {
			return i;
		}
	}
	return -1;
}

const struct app_alarm_rule *app_alarm_rules_find(enum app_alarm_source source,
						  enum app_alarm_quantity quantity)
{
	int i = find_idx(source, quantity);
	return (i >= 0) ? &m_rules[i] : NULL;
}

int app_alarm_rules_set(const struct app_alarm_rule *rule)
{
	if (rule == NULL || !app_alarm_rule_valid((enum app_alarm_source)rule->source,
						  (enum app_alarm_quantity)rule->quantity)) {
		return -EINVAL;
	}

	k_mutex_lock(&m_lock, K_FOREVER);
	int i = find_idx((enum app_alarm_source)rule->source,
			 (enum app_alarm_quantity)rule->quantity);
	if (i < 0) {
		if (m_count >= APP_ALARM_RULE_MAX) {
			k_mutex_unlock(&m_lock);
			return -ENOSPC;
		}
		i = m_count++;
	}
	m_rules[i] = *rule;
	k_mutex_unlock(&m_lock);
	return 0;
}

int app_alarm_rules_clear(enum app_alarm_source source, enum app_alarm_quantity quantity)
{
	k_mutex_lock(&m_lock, K_FOREVER);
	int i = find_idx(source, quantity);
	if (i < 0) {
		k_mutex_unlock(&m_lock);
		return -ENOENT;
	}
	/* Compact: move the last rule into the hole. */
	m_rules[i] = m_rules[--m_count];
	k_mutex_unlock(&m_lock);
	return 0;
}

void app_alarm_rules_clear_all(void)
{
	k_mutex_lock(&m_lock, K_FOREVER);
	m_count = 0;
	k_mutex_unlock(&m_lock);
}

/* ---- persistence (settings blob) --------------------------------------- */

struct rules_blob {
	uint8_t version;
	uint8_t count;
	struct app_alarm_rule rules[APP_ALARM_RULE_MAX];
};

static int rules_settings_set(const char *name, size_t len, settings_read_cb read_cb, void *cb_arg)
{
	const char *next;
	if (!settings_name_steq(name, "rules", &next) || next) {
		return -ENOENT;
	}

	struct rules_blob blob;
	if (len > sizeof(blob)) {
		return -EINVAL;
	}
	ssize_t n = read_cb(cb_arg, &blob, len);
	if (n < (ssize_t)offsetof(struct rules_blob, rules) || blob.version != BLOB_VERSION) {
		LOG_WRN("alarm rules blob ignored (len=%d, version=%u)", (int)n, blob.version);
		return 0;
	}
	if (blob.count > APP_ALARM_RULE_MAX) {
		blob.count = APP_ALARM_RULE_MAX;
	}
	/* Drop any rule that no longer validates (e.g. enum changed across FW). */
	m_count = 0;
	for (int i = 0; i < blob.count; i++) {
		if (app_alarm_rule_valid((enum app_alarm_source)blob.rules[i].source,
					 (enum app_alarm_quantity)blob.rules[i].quantity)) {
			m_rules[m_count++] = blob.rules[i];
		}
	}
	LOG_INF("Loaded %u alarm rule(s)", m_count);
	return 0;
}

static struct settings_handler m_sh = {
	.name = SETTINGS_SUBTREE,
	.h_set = rules_settings_set,
};

int app_alarm_rules_save(void)
{
	k_mutex_lock(&m_lock, K_FOREVER);
	struct rules_blob blob = {.version = BLOB_VERSION, .count = m_count};
	memcpy(blob.rules, m_rules, (size_t)m_count * sizeof(m_rules[0]));
	size_t len = offsetof(struct rules_blob, rules) + (size_t)m_count * sizeof(m_rules[0]);
	k_mutex_unlock(&m_lock);

	int ret = settings_save_one(SETTINGS_KEY, &blob, len);
	if (ret) {
		LOG_ERR_CALL_FAILED_INT("settings_save_one", ret);
	}
	return ret;
}

int app_alarm_rules_init(void)
{
	k_mutex_init(&m_lock);

	int ret = settings_register(&m_sh);
	if (ret && ret != -EEXIST) {
		LOG_ERR_CALL_FAILED_INT("settings_register", ret);
		return ret;
	}
	ret = settings_load_subtree(SETTINGS_SUBTREE);
	if (ret) {
		LOG_ERR_CALL_FAILED_INT("settings_load_subtree", ret);
	}
	return ret;
}
```

## src/app_alarm_rules.h
```c
/*
 * Copyright (c) 2026 HARDWARIO a.s.
 *
 * SPDX-License-Identifier: Apache-2.0
 */

#ifndef APP_ALARM_RULES_H_
#define APP_ALARM_RULES_H_

/* Dynamic alarm rules — a small, persisted list of {source, quantity, condition}
 * rules that unifies every alarm (onboard sensors, ROM-bound 1-Wire slots,
 * discrete inputs and counters) under one model. Replaces the fixed per-source
 * flat config keys: a new sensor quantity is one enum value, and config grows
 * only with the rules actually set. Stored as one settings blob (storage NVS),
 * max APP_ALARM_RULE_MAX rules.
 *
 * A rule's kind is derived from its quantity:
 *  - THRESHOLD (analog): lo/hi/hst hysteresis band — temperature, humidity,
 *    pressure, illuminance, magnetic_field.
 *  - STATE (digital 0/1): from_state/to_state — from != to is an edge (one-shot
 *    alarm; the red LED blinks for alarm_notif_time), from == to is a level
 *    (alarm active while the state == to). tilt and the discrete inputs.
 *  - COUNT (rate): hi = max counter increase allowed per report interval.
 */

#include <stdbool.h>
#include <stdint.h>

#ifdef __cplusplus
extern "C" {
#endif

#define APP_ALARM_RULE_MAX 16

/* Physical sensor a rule targets. Slot 1..4 mirror the telemetry/history slot
 * model (ROM-bound w1[0..3]). Discrete + counter sources reuse these too. */
enum app_alarm_source {
	APP_ALARM_SRC_ONBOARD = 0, /* on-board SHT4x / MPL3115A2 */
	APP_ALARM_SRC_SLOT1 = 1,
	APP_ALARM_SRC_SLOT2 = 2,
	APP_ALARM_SRC_SLOT3 = 3,
	APP_ALARM_SRC_SLOT4 = 4,
	APP_ALARM_SRC_HALL_LEFT = 5,
	APP_ALARM_SRC_HALL_RIGHT = 6,
	APP_ALARM_SRC_INPUT_A = 7,
	APP_ALARM_SRC_INPUT_B = 8,
	APP_ALARM_SRC_PIR = 9,
	APP_ALARM_SRC_ACCEL = 10,
	APP_ALARM_SRC_COUNT
};

/* What is measured. THRESHOLD quantities use lo/hi/hst; STATE uses from/to;
 * COUNT uses hi as the per-interval rate limit. Extend here + in the validity
 * table; the wire (AlarmEvent.quantity) and ttn.js mirror these values. */
enum app_alarm_quantity {
	APP_ALARM_Q_TEMPERATURE = 0,
	APP_ALARM_Q_HUMIDITY = 1,
	APP_ALARM_Q_PRESSURE = 2,
	APP_ALARM_Q_ILLUMINANCE = 3,
	APP_ALARM_Q_MAGNETIC_FIELD = 4,
	APP_ALARM_Q_TILT = 5,  /* digital (STATE) */
	APP_ALARM_Q_STATE = 6, /* digital line of a discrete input (STATE) */
	APP_ALARM_Q_COUNT = 7, /* counter rate (COUNT) */
	APP_ALARM_Q_FLOOD = 8, /* flood probe AIN2 voltage in mV (THRESHOLD) */
	APP_ALARM_Q_QUANTITY_COUNT
};

enum app_alarm_kind {
	APP_ALARM_KIND_THRESHOLD, /* lo/hi/hst */
	APP_ALARM_KIND_STATE,     /* from_state/to_state */
	APP_ALARM_KIND_RATE,      /* hi = max delta per report interval */
};

struct app_alarm_rule {
	uint8_t source;   /* enum app_alarm_source */
	uint8_t quantity; /* enum app_alarm_quantity */
	uint8_t enabled;
	uint8_t from_state; /* STATE only: previous level (0/1) */
	uint8_t to_state;   /* STATE only: triggering level (0/1); from==to => level */
	float lo, hi, hst;  /* THRESHOLD (and hi for RATE) */
};

/* Load rules from settings (called once at init, after settings_subsys_init). */
int app_alarm_rules_init(void);

/* The kind implied by a quantity (THRESHOLD / STATE / RATE). */
enum app_alarm_kind app_alarm_quantity_kind(enum app_alarm_quantity q);

/* True if (source, quantity) is a structurally valid pair (onboard → temp/hum/
 * pressure; slot → temp/hum/lux/mag/tilt; hall/input → state/count; pir/accel →
 * state/count). Does not require the sensor to be present (provisioning may set
 * a slot rule before the sensor is enrolled). */
bool app_alarm_rule_valid(enum app_alarm_source source, enum app_alarm_quantity quantity);

/* Number of stored rules, and indexed access (0..count-1). */
uint8_t app_alarm_rules_count(void);
const struct app_alarm_rule *app_alarm_rules_get(uint8_t idx);

/* Find the rule for (source, quantity), or NULL. */
const struct app_alarm_rule *app_alarm_rules_find(enum app_alarm_source source,
						  enum app_alarm_quantity quantity);

/* Upsert a rule (one per source+quantity). Returns 0, -EINVAL (bad pair),
 * -ENOSPC (table full). Does not persist — call app_alarm_rules_save(). */
int app_alarm_rules_set(const struct app_alarm_rule *rule);

/* Remove the rule for (source, quantity); -ENOENT if none. Not persisted. */
int app_alarm_rules_clear(enum app_alarm_source source, enum app_alarm_quantity quantity);

/* Remove all rules. Not persisted. */
void app_alarm_rules_clear_all(void);

/* Persist the current rule list to settings (storage NVS). */
int app_alarm_rules_save(void);

/* Names for shell / decoder parity. */
const char *app_alarm_source_name(enum app_alarm_source source);
const char *app_alarm_quantity_name(enum app_alarm_quantity quantity);
int app_alarm_source_by_name(const char *name);   /* -1 if unknown */
int app_alarm_quantity_by_name(const char *name); /* -1 if unknown */

#ifdef __cplusplus
}
#endif

#endif /* APP_ALARM_RULES_H_ */
```

## src/app_config.h
```c
/* WARNING: This file is auto-generated by `west configen`. Do not modify manually. */

/*
 * Copyright (c) 2025 HARDWARIO a.s.
 *
 * SPDX-License-Identifier: Apache-2.0
 */

#ifndef APP_CONFIG_H_
#define APP_CONFIG_H_

/* Standard includes */
#include <stdbool.h>
#include <stdint.h>

#ifdef __cplusplus
extern "C" {
#endif

enum app_config_lrw_region {
	APP_CONFIG_LRW_REGION_EU868 = 0,
	APP_CONFIG_LRW_REGION_US915 = 1,
	APP_CONFIG_LRW_REGION_AU915 = 2,
};

enum app_config_lrw_network {
	APP_CONFIG_LRW_NETWORK_PUBLIC = 0,
	APP_CONFIG_LRW_NETWORK_PRIVATE = 1,
};

enum app_config_lrw_activation {
	APP_CONFIG_LRW_ACTIVATION_OTAA = 0,
	APP_CONFIG_LRW_ACTIVATION_ABP = 1,
};

#define APP_CONFIG_VERSION 1

struct app_config {
	uint32_t config_version;
	uint8_t secret_key[16];
	uint32_t serial_number;
	uint32_t nonce_counter;
	bool calibration;
	int interval_sample;
	int interval_report;
	enum app_config_lrw_region lrw_region;
	int lrw_sub_band;
	enum app_config_lrw_region last_applied_region;
	enum app_config_lrw_network lrw_network;
	bool lrw_adr;
	enum app_config_lrw_activation lrw_activation;
	uint8_t lrw_deveui[8];
	uint8_t lrw_joineui[8];
	uint8_t lrw_nwkkey[16];
	uint8_t lrw_appkey[16];
	uint8_t lrw_devaddr[4];
	uint8_t lrw_nwkskey[16];
	uint8_t lrw_appskey[16];
	bool alarm_temperature_enabled;
	float alarm_temperature_lo;
	float alarm_temperature_hi;
	float alarm_temperature_hst;
	bool alarm_humidity_enabled;
	float alarm_humidity_lo;
	float alarm_humidity_hi;
	float alarm_humidity_hst;
	bool alarm_pressure_enabled;
	float alarm_pressure_lo;
	float alarm_pressure_hi;
	float alarm_pressure_hst;
	bool alarm_t1_temperature_enabled;
	float alarm_t1_temperature_lo;
	float alarm_t1_temperature_hi;
	float alarm_t1_temperature_hst;
	bool alarm_t2_temperature_enabled;
	float alarm_t2_temperature_lo;
	float alarm_t2_temperature_hi;
	float alarm_t2_temperature_hst;
	bool hall_left_counter;
	bool hall_left_notify_act;
	bool hall_left_notify_deact;
	bool hall_right_counter;
	bool hall_right_notify_act;
	bool hall_right_notify_deact;
	bool input_a_counter;
	bool input_a_notify_act;
	bool input_a_notify_deact;
	bool input_b_counter;
	bool input_b_notify_act;
	bool input_b_notify_deact;
	float corr_temperature;
	float corr_t1_temperature;
	float corr_t2_temperature;
	bool cap_hall_left;
	bool cap_hall_right;
	bool cap_input_a;
	bool cap_input_b;
	bool cap_light_sensor;
	bool cap_barometer;
	bool cap_pir_detector;
	bool cap_1w_thermometer;
	bool cap_1w_machine_probe;
};

extern struct app_config g_app_config;

struct app_config *app_config(void);

#ifdef __cplusplus
}
#endif

#endif /* APP_CONFIG_H_ */
```

## src/app_flood_probe.h
```c
/*
 * Copyright (c) 2025 HARDWARIO a.s.
 *
 * SPDX-License-Identifier: Apache-2.0
 */

#ifndef APP_FLOOD_PROBE_H_
#define APP_FLOOD_PROBE_H_

/* Standard includes */
#include <stdint.h>

#ifdef __cplusplus
extern "C" {
#endif

/* Flood probe: the HARDWARIO "weight probe" board (ADS122C04 ADC behind a DS28E17
 * 1-Wire-to-I2C bridge, family 0x19) repurposed for a resistive flood/water
 * sensor. The ADS122C04 drives a 1500 uA current source into AIN2 and measures
 * the voltage on AIN2 (single-ended vs AVSS); a wet sensor (low resistance) pulls
 * the voltage down, a dry/open sensor lets it rise toward the rail. */

/* Scan the 1-Wire bus for flood probes. Mirrors app_machine_probe_scan(): a
 * family 0x19 device whose ADS122C04 does not answer is skipped here and left to
 * the machine-probe driver, so the two coexist on one bus. Returns 0 or errno. */
int app_flood_probe_scan(void);

/* Number of flood probes registered by the last scan. */
int app_flood_probe_get_count(void);

/* Read one flood probe's raw ADC sample. index is 0-based (0..count-1). *raw
 * receives the signed 24-bit ADS122C04 count for the AIN2 voltage (sign-extended
 * to int32); the conversion to millivolts happens in the slot layer. *serial_number
 * (may be NULL) receives the 48-bit 1-Wire ROM serial. Returns 0 or errno. */
int app_flood_probe_read(int index, uint64_t *serial_number, int32_t *raw);

#ifdef __cplusplus
}
#endif

#endif /* APP_FLOOD_PROBE_H_ */
```
